## added_files/poky/build/conf/bblayers.conf
```bitbake
# POKY_BBLAYERS_CONF_VERSION is increased each time build/conf/bblayers.conf
# changes incompatibly
POKY_BBLAYERS_CONF_VERSION = "2"

BBPATH = "${TOPDIR}"
BBFILES ?= ""

BBLAYERS ?= " \
  /home/bogdan/Desktop/SI/poky/meta \
  /home/bogdan/Desktop/SI/poky/meta-poky \
  /home/bogdan/Desktop/SI/poky/meta-yocto-bsp \
  /home/bogdan/Desktop/SI/poky/meta-raspberrypi \
  /home/bogdan/Desktop/SI/poky/meta-custom \
  "
```
